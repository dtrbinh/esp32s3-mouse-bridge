## apps/ble_mouse_debug/sdkconfig.defaults
```kconfig
CONFIG_IDF_TARGET="esp32s3"
CONFIG_ESPTOOLPY_FLASHSIZE_8MB=y
CONFIG_PARTITION_TABLE_SINGLE_APP_LARGE=y
CONFIG_COMPILER_OPTIMIZATION_DEFAULT=y
CONFIG_SPIRAM=y
CONFIG_SPIRAM_MODE_OCT=y
CONFIG_FREERTOS_HZ=1000

CONFIG_BT_ENABLED=y
CONFIG_BT_NIMBLE_ENABLED=y
CONFIG_BT_NIMBLE_ROLE_CENTRAL=y
CONFIG_BT_NIMBLE_MAX_CONNECTIONS=1
CONFIG_BT_NIMBLE_SECURITY_ENABLE=y

CONFIG_ESP_CONSOLE_USB_SERIAL_JTAG=y
```

## apps/ble_only/main/Kconfig.projbuild
```kconfig
menu "BLE-only mouse bridge"

config BLE_ONLY_DEFAULT_PROFILE
    int "Default movement profile (1-7)"
    range 1 7
    default 1
    help
        Selects the power-on profile. A short BOOT press advances to the
        next profile and wraps after profile 7.

config BLE_ONLY_LED_GPIO
    int "Onboard WS2812 GPIO"
    range 0 48
    default 21
    help
        GPIO for the single onboard WS2812 status LED. Waveshare
        ESP32-S3-Zero boards use GPIO21.

endmenu
```

## apps/ble_only/sdkconfig.defaults
```kconfig
CONFIG_IDF_TARGET="esp32s3"
CONFIG_ESPTOOLPY_FLASHSIZE_8MB=y
CONFIG_PARTITION_TABLE_CUSTOM=y
CONFIG_PARTITION_TABLE_CUSTOM_FILENAME="partitions_n8r8.csv"
CONFIG_COMPILER_OPTIMIZATION_PERF=y
CONFIG_SPIRAM=y
CONFIG_SPIRAM_MODE_OCT=y
CONFIG_FREERTOS_HZ=1000
CONFIG_ESP_MAIN_TASK_AFFINITY_CPU1=y
CONFIG_BT_ENABLED=y
CONFIG_BT_NIMBLE_ENABLED=y
CONFIG_BT_NIMBLE_ROLE_CENTRAL=y
CONFIG_BT_NIMBLE_MAX_CONNECTIONS=1
CONFIG_ESP_WIFI_TASK_PINNED_TO_CORE_1=y
CONFIG_ESP_WIFI_NVS_ENABLED=n
CONFIG_ESP_WIFI_ENTERPRISE_SUPPORT=n
CONFIG_HTTPD_ENABLE_EVENTS=n
CONFIG_LWIP_IPV6=n
CONFIG_LWIP_TCPIP_TASK_AFFINITY_CPU0=y
CONFIG_BT_NIMBLE_SECURITY_ENABLE=y
CONFIG_BT_NIMBLE_PINNED_TO_CORE_0=y
CONFIG_TINYUSB_HID_COUNT=1
CONFIG_TINYUSB_CDC_ENABLED=y
CONFIG_TINYUSB_CDC_COUNT=1
CONFIG_BLE_ONLY_DEFAULT_PROFILE=1
CONFIG_ESP_TASK_WDT_EN=y
CONFIG_ESP_TASK_WDT_INIT=y
```

## apps/input/main/Kconfig.projbuild
```kconfig
menu "Mouse bridge input"

config MOUSE_BRIDGE_PROFILE_ENABLED
    bool "Enable movement profile engine"
    default y
    help
        Enables the timestamp-driven profile engine. GPIO0 on the output board
        still provides an emergency physical-motion bypass.

config MOUSE_BRIDGE_DEFAULT_PROFILE
    int "Default movement profile (1-14)"
    range 1 14
    default 1
    help
        Selects the power-on profile. Mouse buttons 4 and 5 select profiles 1
        and 2 at runtime.

endmenu
```

## apps/input/sdkconfig.defaults
```kconfig
CONFIG_IDF_TARGET="esp32s3"
CONFIG_ESPTOOLPY_FLASHSIZE_4MB=y
CONFIG_SPIRAM=y
CONFIG_SPIRAM_MODE_OCT=y
CONFIG_BT_ENABLED=y
CONFIG_BT_NIMBLE_ENABLED=y
CONFIG_BT_NIMBLE_ROLE_CENTRAL=y
CONFIG_BT_NIMBLE_MAX_CONNECTIONS=1
CONFIG_BT_NIMBLE_NVS_PERSIST=y
CONFIG_BT_NIMBLE_MAX_BONDS=1
CONFIG_BT_NIMBLE_SECURITY_ENABLE=y
CONFIG_BT_NIMBLE_HID_SERVICE=y
CONFIG_MOUSE_BRIDGE_PROFILE_ENABLED=y
CONFIG_MOUSE_BRIDGE_DEFAULT_PROFILE=1
CONFIG_ESP_TASK_WDT_EN=y
CONFIG_ESP_TASK_WDT_INIT=y
```

## apps/output/main/Kconfig.projbuild
```kconfig
menu "Mouse bridge output"

config MOUSE_BRIDGE_CDC_DIAGNOSTICS
    bool "Enable CDC diagnostics and profile commands"
    default n
    help
        Adds a CDC interface for development diagnostics. Keep disabled for
        final latency measurements.

endmenu
```

## apps/output/sdkconfig.defaults
```kconfig
CONFIG_IDF_TARGET="esp32s3"
CONFIG_ESPTOOLPY_FLASHSIZE_4MB=y
CONFIG_SPIRAM=y
CONFIG_SPIRAM_MODE_OCT=y
CONFIG_FREERTOS_HZ=1000
CONFIG_TINYUSB_HID_COUNT=1
CONFIG_MOUSE_BRIDGE_CDC_DIAGNOSTICS=n
```
